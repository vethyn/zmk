/ {
    combos {
        compatible = "zmk,combos";

        combo_caps_word {
            timeout-ms = <100>;
            key-positions = <20 29>;
            bindings = <&caps_word>;
        };

        combo_esc {
            timeout-ms = <100>;
            key-positions = <13 16>;
            bindings = <&kp ESC>;
        };

        combo_minus {
            timeout-ms = <80>;
            key-positions = <3 6>;
            bindings = <&kp MINUS>;
        };

        combo_under {
            timeout-ms = <80>;
            key-positions = <23 26>;
            bindings = <&kp UNDER>;
        };

        combo_ble {
            timeout-ms = <20>;
            key-positions = <0 1>;
            bindings = <&out OUT_BLE>;
        };

        go_to_layer_2 {
            bindings = <&to 2>;
            key-positions = <30 33>;
            layers = <0 3 1>;
        };

        go_to_layer_0_from_2 {
            bindings = <&to 0>;
            key-positions = <30 33>;
            layers = <2>;
        };

        go_to_layer_1 {
            bindings = <&to 1>;
            key-positions = <31 32>;
            layers = <0 2 3>;
        };

        go_to_layer_0_from_1 {
            bindings = <&to 0>;
            key-positions = <31 32>;
            layers = <1>;
        };

        go_to_layer_3 {
            bindings = <&to 3>;
            key-positions = <8 9>;
            layers = <0 1 2>;
        };

        go_to_layer_0_from_3 {
            bindings = <&to 0>;
            key-positions = <9 8>;
            layers = <3>;
        };
        
        go_to_layer_4 {
            bindings = <&to 4>;
            key-positions = <9 19>;
            layers = <0 1 2 3>;
        };
        
        go_to_layer_0_from_4 {
            bindings = <&to 0>;
            key-positions = <9 19>;
            layers = <4>;
        };

        vim_end_of_line {
            bindings = <&kp DOLLAR>;
            key-positions = <10 19>;
        };

        vim_start_of_line {
            bindings = <&kp NUMBER_0>;
            key-positions = <14 15>;
        };

        slash {
            bindings = <&kp SLASH>;
            key-positions = <31 29>;
            layers = <0>;
        };
    };
